## boards/shields/tworne/Kconfig.defconfig
```kconfig
if SHIELD_TWORNE_LEFT

config ZMK_KEYBOARD_NAME
    default "TWORNE"
    
config ZMK_SPLIT_ROLE_CENTRAL
    default y

endif

if SHIELD_TWORNE_LEFT || SHIELD_TWORNE_RIGHT

config ZMK_SPLIT
    default y

endif
```

## boards/shields/tworne/Kconfig.shield
```kconfig
config SHIELD_TWORNE_LEFT
    def_bool $(shields_list_contains,tworne_left)

config SHIELD_TWORNE_RIGHT
    def_bool $(shields_list_contains,tworne_right)
```
